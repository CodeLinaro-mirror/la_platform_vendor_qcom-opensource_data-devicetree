// SPDX-License-Identifier: BSD-3-Clause
/*
 * Copyright (c) Qualcomm Technologies, Inc. and/or its subsidiaries.
 */

/dts-v1/;
/plugin/;

#include <dt-bindings/interrupt-controller/arm-gic.h>
#include <dt-bindings/soc/qcom,ipcc.h>
#include <dt-bindings/interconnect/qcom,diwali.h>
#include <dt-bindings/clock/qcom,fillmore-gcc.h>
#include <dt-bindings/clock/qcom,rpmh.h>
#include "diwali-ipa.dtsi"

/ {
	model = "Qualcomm Technologies, Inc. Diwali SoC";
	compatible = "qcom,diwali", "qcom,diwali-atp", "qcom,atp",
					"qcom,diwali-idp", "qcom,idp",
					"qcom,diwali-lte-atp", "qcom,diwali-lte", "qcom,diwali-lte-idp",
					"qcom,diwali-lte-qrd", "qcom,qrd", "qcom,diwali-qrd";
	qcom,msm-id = <506 0x10000>, <547 0x10000>, <564 0x10000>;
	qcom,board-id = <0 0>, <33 0>, <0 2>, <34 0>, <34 1>, <34 2>, <34 3>, <0x1000B 0>;
};
